## make/libs/liburcu/Config.in
```kconfig
menu "liburcu"

	config FREETZ_LIB_liburcu
		bool "liburcu (liburcu.so)"
		select FREETZ_LIB_liburcu_common
		default n
		help
			liburcu is a LGPLv2.1 userspace RCU (read-copy-update)
			library. This data synchronization library provides read-side
			access which scales linearly with the number of cores.

	config FREETZ_LIB_liburcu_bp
		bool "liburcu-bp (liburcu-bp.so)"
		select FREETZ_LIB_liburcu_common
		default n

	config FREETZ_LIB_liburcu_cds
		bool "liburcu-cds (liburcu-cds.so)"
		select FREETZ_LIB_liburcu_common
		default n

	config FREETZ_LIB_liburcu_common
		bool "liburcu-common (liburcu-common.so)"
		default n

	config FREETZ_LIB_liburcu_mb
		bool "liburcu-mb (liburcu-mb.so)"
		select FREETZ_LIB_liburcu_common
		default n

	config FREETZ_LIB_liburcu_memb
		bool "liburcu-memb (liburcu-memb.so)"
		select FREETZ_LIB_liburcu_common
		default n

	config FREETZ_LIB_liburcu_qsbr
		bool "liburcu-qsbr (liburcu-qsbr.so)"
		select FREETZ_LIB_liburcu_common
		default n

	config FREETZ_LIB_liburcu_signal
		bool "liburcu-signal (liburcu-signal.so)"
		select FREETZ_LIB_liburcu_common
		default n

endmenu ### "liburcu"
```

## make/pkgs/avm-portfw/Config.in
```kconfig
config FREETZ_PACKAGE_AVM_PORTFW
	bool "AVM-portfw"
	depends on FREETZ_AVM_HAS_DSLD
	depends on !FREETZ_REMOVE_DSLD
#	depends on FREETZ_AVM_VERSION_06_8X_MIN && FREETZ_AVM_VERSION_07_5X_MAX
	default n
	help
		For FritzOS 6.8x - 7.57 only (up to ar7cfg_version=24).
		Configuration of port forwardings to the FritzBox itself
		by using internet_forwardrules.
		Warning:
		This package changes the ar7.cfg. On syntax errors AVM
		will reset the whole file to default, including default
		password and default ip. Backup you config before!
```

## make/pkgs/avm-rules/Config.in
```kconfig
config FREETZ_PACKAGE_AVM_RULES
	bool "AVM-rules"
	depends on FREETZ_AVM_HAS_DSLD
	depends on !FREETZ_REMOVE_DSLD
	depends on FREETZ_AVM_VERSION_07_5X_MIN
	default n
	select FREETZ_BUSYBOX_START_STOP_DAEMON
	help
		For FritzOS since v7.5x only.
		Configuration of port forwardings to the FritzBox itself
		by using pcplisten.
		This avm tool can open ports for not more than 120 seconds.
		The steady renewal is managed by this package.
		MSC: added IPv6 support
```

## make/pkgs/bind/Config.in
```kconfig
config FREETZ_PACKAGE_BIND
	bool "BIND 9.11.37/9.20.3"
	select FREETZ_LIB_libdns             if !FREETZ_PACKAGE_BIND_VERSION_ABANDON
	select FREETZ_LIB_libisc             if !FREETZ_PACKAGE_BIND_VERSION_ABANDON
	select FREETZ_LIB_libisccfg          if !FREETZ_PACKAGE_BIND_VERSION_ABANDON
	select FREETZ_LIB_libpthread         if FREETZ_TARGET_UCLIBC_HAS_multiple_libs
	select FREETZ_LIB_libatomic          if !FREETZ_PACKAGE_BIND_VERSION_ABANDON
	select FREETZ_LIB_liburcu            if !FREETZ_PACKAGE_BIND_VERSION_ABANDON
	select FREETZ_LIB_liburcu_cds        if !FREETZ_PACKAGE_BIND_VERSION_ABANDON
	select FREETZ_LIB_liburcu_common     if !FREETZ_PACKAGE_BIND_VERSION_ABANDON
	default n
	help
		BIND is a suite of software for interacting with the Domain Name System (DNS).
		The name BIND stands for "Berkeley Internet Name Daemon".

if FREETZ_PACKAGE_BIND

	choice
		prompt "Version"
			default FREETZ_PACKAGE_BIND_VERSION_CURRENT
			help
				 - libatomic needs uclibc >0.9.29
				 - libcap needs gcc 4.8+
				 - liburcu needs gcc 4.8+
				 - libuv needs gcc 5+

		config FREETZ_PACKAGE_BIND_VERSION_ABANDON
			bool "9.11.37"
#			depends on !(FREETZ_TARGET_GCC_5_MIN && !(FREETZ_TARGET_UCLIBC_0_9_28 || FREETZ_TARGET_UCLIBC_0_9_29))

		config FREETZ_PACKAGE_BIND_VERSION_CURRENT
			bool "9.20.3"
			depends on  (FREETZ_TARGET_GCC_5_MIN && !(FREETZ_TARGET_UCLIBC_0_9_28 || FREETZ_TARGET_UCLIBC_0_9_29))

	endchoice

	config FREETZ_PACKAGE_BIND_NAMED
		bool "named"
		default y
		select FREETZ_LIB_libisccc           if !FREETZ_PACKAGE_BIND_VERSION_ABANDON
		select FREETZ_LIB_libns              if !FREETZ_PACKAGE_BIND_VERSION_ABANDON
		select FREETZ_LIB_libcap             if !FREETZ_PACKAGE_BIND_VERSION_ABANDON
		select FREETZ_LIB_libcrypto          if !FREETZ_PACKAGE_BIND_VERSION_ABANDON
		select FREETZ_LIB_libcrypto_WITH_EC  if !FREETZ_PACKAGE_BIND_VERSION_ABANDON
		select FREETZ_LIB_libssl             if !FREETZ_PACKAGE_BIND_VERSION_ABANDON
		select FREETZ_LIB_libuv              if !FREETZ_PACKAGE_BIND_VERSION_ABANDON
		help
			named is a DNS server, part of the BIND 9 distribution.
			You have to provide the config and needed zone files yourself.
			This file needs about 3,5 MB uncompressed.

		comment "HINT: Don't forget to enable the DNS server."
		depends on FREETZ_PACKAGE_BIND_NAMED && \
			FREETZ_AVMDAEMON_DISABLE_DNS

		config FREETZ_PACKAGE_BIND_NAMED_DISABLE_DNS
			bool "Disable multid's DNS"
			depends on FREETZ_PACKAGE_BIND_NAMED
			depends on FREETZ_AVM_HAS_AVMMULTID_PRELOAD
			select FREETZ_AVMDAEMON_DISABLE_MULTIDPORTS
			select FREETZ_AVMDAEMON_DISABLE_DNS
			select FREETZ_AVMDAEMON_DISABLE_LLMNR
			default y
			help
				This selects the remapping of multid's DNS (and LLMNR) ports.

	config FREETZ_PACKAGE_BIND_RNDC
		bool "rndc (binary only)"
		select FREETZ_LIB_libisccc           if !FREETZ_PACKAGE_BIND_VERSION_ABANDON
		default n
		help
			rndc allows you to use command line statements to administer the named daemon.
			This file needs about 0,5 MB uncompressed.

	config FREETZ_PACKAGE_BIND_NSUPDATE
		bool "nsupdate (binary only)"
		default n
		help
			nsupdate is used to submit Dynamic DNS Update requests to a name server.
			This file needs about 2,8 MB uncompressed.

	config FREETZ_PACKAGE_BIND_DIG
		bool "dig (binary only)"
		default n
		help
			dig is a flexible tool for interrogating DNS name servers.
			This file needs about 2,8 MB uncompressed.

	config FREETZ_PACKAGE_BIND_HOST
		bool "host (binary only)"
		default n
		help
			host is a simple utility for performing DNS lookups.
			This file needs about 2,8 MB uncompressed.

	config FREETZ_PACKAGE_BIND_NSLOOKUP
		bool "nslookup (binary only)"
		default n
		help
			nslookup is a program to query Internet domain name servers.
			This file needs about 2,8 MB uncompressed.

	config FREETZ_PACKAGE_BIND_DDNS_CONFGEN
		bool "ddns-confgen (binary only)"
		select FREETZ_LIB_libirs     if !FREETZ_PACKAGE_BIND_VERSION_ABANDON
		default n

        config FREETZ_PACKAGE_BIND_RNDC_CONFGEN
                bool "rndc-confgen (binary only)"
                select FREETZ_LIB_libirs     if !FREETZ_PACKAGE_BIND_VERSION_ABANDON
                default n

        config FREETZ_PACKAGE_BIND_TSIG_KEYGEN
                bool "tsig-keygen (binary only)"
                select FREETZ_LIB_libirs     if !FREETZ_PACKAGE_BIND_VERSION_ABANDON
                default n

        config FREETZ_PACKAGE_BIND_NAMED_CHECKCONF
                bool "named-checkconf (binary only)"
                select FREETZ_LIB_libirs     if !FREETZ_PACKAGE_BIND_VERSION_ABANDON
                default n

        config FREETZ_PACKAGE_BIND_NAMED_CHECKZONE
                bool "named-checkzone (binary only)"
                select FREETZ_LIB_libirs     if !FREETZ_PACKAGE_BIND_VERSION_ABANDON
                default n

        config FREETZ_PACKAGE_BIND_NAMED_JOURNALPRINT
                bool "named-journalprint (binary only)"
                select FREETZ_LIB_libirs     if !FREETZ_PACKAGE_BIND_VERSION_ABANDON
                default n

        config FREETZ_PACKAGE_BIND_NAMED_RRCHECKER
                bool "named-rrchecker (binary only)"
                select FREETZ_LIB_libirs     if !FREETZ_PACKAGE_BIND_VERSION_ABANDON
                default n

        config FREETZ_PACKAGE_BIND_NSEC3HASH
                bool "nsec3hash (binary only)"
                select FREETZ_LIB_libirs     if !FREETZ_PACKAGE_BIND_VERSION_ABANDON
                default n

        config FREETZ_PACKAGE_BIND_DNSSEC_CDS
                bool "dnssec-cds (binary only)"
                select FREETZ_LIB_libirs     if !FREETZ_PACKAGE_BIND_VERSION_ABANDON
                default n

        config FREETZ_PACKAGE_BIND_DNSSEC_DSFROMKEY
                bool "dnssec-dsfromkey (binary only)"
                select FREETZ_LIB_libirs     if !FREETZ_PACKAGE_BIND_VERSION_ABANDON
                default n

        config FREETZ_PACKAGE_BIND_DNSSEC_IMPORTKEY
                bool "dnssec-importkey (binary only)"
                select FREETZ_LIB_libirs     if !FREETZ_PACKAGE_BIND_VERSION_ABANDON
                default n

        config FREETZ_PACKAGE_BIND_DNSSEC_KEYFROMLABEL
                bool "dnssec-keyfromlabel (binary only)"
                select FREETZ_LIB_libirs     if !FREETZ_PACKAGE_BIND_VERSION_ABANDON
                default n

        config FREETZ_PACKAGE_BIND_DNSSEC_KEYGEN
                bool "dnssec-keygen (binary only)"
                select FREETZ_LIB_libirs     if !FREETZ_PACKAGE_BIND_VERSION_ABANDON
                default n

        config FREETZ_PACKAGE_BIND_DNSSEC_REVOKE
                bool "dnssec-revoke (binary only)"
                select FREETZ_LIB_libirs     if !FREETZ_PACKAGE_BIND_VERSION_ABANDON
                default n

        config FREETZ_PACKAGE_BIND_DNSSEC_SETTIME
                bool "dnssec-settime (binary only)"
                select FREETZ_LIB_libirs     if !FREETZ_PACKAGE_BIND_VERSION_ABANDON
                default n

        config FREETZ_PACKAGE_BIND_DNSSEC_SIGNZONE
                bool "dnssec-signzone (binary only)"
                select FREETZ_LIB_libirs     if !FREETZ_PACKAGE_BIND_VERSION_ABANDON
                default n

        config FREETZ_PACKAGE_BIND_DNSSEC_VERIFY
                bool "dnssec-verify (binary only)"
                select FREETZ_LIB_libirs     if !FREETZ_PACKAGE_BIND_VERSION_ABANDON
                default n

	config FREETZ_PACKAGE_BIND_ARPANAME # bind9
		bool "arpaname (binary only)"
		select FREETZ_LIB_libisc	if !FREETZ_PACKAGE_BIND_VERSION_ABANDON
		default n

	config FREETZ_PACKAGE_BIND_DELV # bind9-dnsutils
		bool "delv (binary only)"
		select FREETZ_LIB_libdns	if !FREETZ_PACKAGE_BIND_VERSION_ABANDON
		select FREETZ_LIB_libisc	if !FREETZ_PACKAGE_BIND_VERSION_ABANDON
		select FREETZ_LIB_libirs	if !FREETZ_PACKAGE_BIND_VERSION_ABANDON
		select FREETZ_LIB_libisccfg	if !FREETZ_PACKAGE_BIND_VERSION_ABANDON
		default n

	config FREETZ_PACKAGE_BIND_MDIG # bind9-dnsutils
		bool "mdig (binary only)"
		select FREETZ_LIB_libdns	if !FREETZ_PACKAGE_BIND_VERSION_ABANDON
		select FREETZ_LIB_libbind9	if !FREETZ_PACKAGE_BIND_VERSION_ABANDON
		select FREETZ_LIB_libisc	if !FREETZ_PACKAGE_BIND_VERSION_ABANDON
		select FREETZ_LIB_libisccfg	if !FREETZ_PACKAGE_BIND_VERSION_ABANDON
		default n

endif # FREETZ_PACKAGE_BIND
```
